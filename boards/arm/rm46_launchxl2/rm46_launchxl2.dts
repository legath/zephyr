/* SPDX-License-Identifier: Apache-2.0 */

/dts-v1/;

#include <ti/rm46lxxx.dtsi>

/ {
	model = "TI RM46 LaunchXL2";
	compatible = ""ti,rm46lxxx",
						"ti,rm4xlxxx";

	chosen {
		zephyr,sram = &sram0;
		zephyr,flash = &flash0;
		zephyr,console = &uart0;
		zephyr,shell-uart = &uart0;
	};
};

&cpu0 {
	clock-frequency = <220000000>;
};
