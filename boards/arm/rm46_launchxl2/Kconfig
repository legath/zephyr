## boards/arm/rm46_launchxl2/Kconfig.board
```kconfig
# TI RM46 LaunchXL2 Development Board

# SPDX-License-Identifier: Apache-2.0

config BOARD_RM46_LAUNCHXL2
	bool "TI LAUNCHXL2-RM46"
	depends on SOC_RM46LXXX
```

## boards/arm/rm46_launchxl2/Kconfig.defconfig
```kconfig
# TI LaunchXL2-RM46 development board configuration

# SPDX-License-Identifier: Apache-2.0

config BOARD
	default "rm46_launchxl2"
	depends on BOARD_RM46_LAUNCHXL2
```

## boards/arm/rm46_launchxl2/rm46_launchxl2_defconfig
```kconfig
# SPDX-License-Identifier: Apache-2.0

CONFIG_BOARD_RM46_LAUNCHXL2=y

CONFIG_SOC_SERIES_RM4X=y
CONFIG_SOC_RM46LXXX=y

# Floating point options
CONFIG_FPU=y

# enable uart driver
CONFIG_SERIAL=y
#CONFIG_UART_HERCULES_FAMILY=y

# enable console
CONFIG_CONSOLE=y
CONFIG_UART_CONSOLE=y
```

## soc/arm/ti_hercules/Kconfig
```kconfig
# Copyright (c) 2021 Alexander Bulychev <a.f.bulychev@gmail.com>
# SPDX-License-Identifier: Apache-2.0

config SOC_FAMILY_HERCULES
	bool

if SOC_FAMILY_HERCULES

config SOC_FAMILY
	string
	default "ti_hercules"

source "soc/arm/ti_hercules/*/Kconfig.soc"

endif # SOC_FAMILY_HERCULES
```

## soc/arm/ti_hercules/Kconfig.defconfig
```kconfig
# Copyright (c) 2021 Alexander Bulychev <a.f.bulychev@gmail.com>
# SPDX-License-Identifier: Apache-2.0

source "soc/arm/ti_hercules/*/Kconfig.defconfig.series"
```

## soc/arm/ti_hercules/Kconfig.soc
```kconfig
# Texas Instruments Hercules Family

# SPDX-License-Identifier: Apache-2.0

source "soc/arm/ti_hercules/*/Kconfig.series"
```

## soc/arm/ti_hercules/rm4xlxxx/Kconfig.defconfig.rm46lxxx
```kconfig
# TI RM46L852 platform configuration options

# Copyright (c) 2021 Alexander Bulychev <a.f.bulychev@gmail.com>
# SPDX-License-Identifier: Apache-2.0

if SOC_RM46LXXX

config SOC
	default "RM46LXXX"

endif # SOC_RM46LXXX
```

## soc/arm/ti_hercules/rm4xlxxx/Kconfig.defconfig.series
```kconfig
# RM4X series configuration options

# Copyright (c) 2021 Alexander Bulychev <a.f.bulychev@gmail.com>
# SPDX-License-Identifier: Apache-2.0

if SOC_SERIES_RM4X

config SOC_SERIES
	default "rm4xlxxx"


source "soc/arm/ti_hercules/rm4xlxxx/Kconfig.defconfig.rm4*"

endif # SOC_SERIES_RM4X
```

## soc/arm/ti_hercules/rm4xlxxx/Kconfig.series
```kconfig
# Copyright (c) 2021 Alexander Bulychev <a.f.bulychev@gmail.com>
# SPDX-License-Identifier: Apache-2.0

config SOC_SERIES_RM4X
	bool "TI Hercules RM4X"
	select ARM
	select CPU_CORTEX_R4
	select CPU_HAS_FPU
	select GIC_V1
	select SOC_FAMILY_HERCULES
	help
	  Enable support for TI Hercules RM4X series
```

## soc/arm/ti_hercules/rm4xlxxx/Kconfig.soc
```kconfig
# Copyright (c) 2021 Alexander Bulychev <a.f.bulychev@gmail.com>
# SPDX-License-Identifier: Apache-2.0

choice
	prompt "Hercules RM4xLxxx selection"
	depends on SOC_SERIES_RM4X

	config SOC_RM46LXXX
		bool "RM46LXXX"

endchoice
```
