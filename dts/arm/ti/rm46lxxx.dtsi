/*
 * Copyright (c) 2021 Alexander Bulychev <a.f.bulychev@gmail.com>
 *
 * SPDX-License-Identifier: Apache-2.0
 */

#include <mem.h>
#include <ti/rm4xlxxx.dtsi>

/ {
	sram0: memory@8000000 {
		reg = <0x8000000 DT_SIZE_K(192)>;
	};

	flash0: serial-flash@0 {
		reg = <0x0 DT_SIZE_K(1280)>;
	};
};
