/* SPDX-License-Identifier: Apache-2.0 */

#include <arm/armv7-r.dtsi>


/ {
	cpus {
		#address-cells = <1>;
		#size-cells = <0>;

		cpu@0 {
			device_type = "cpu";
			compatible = "arm,cortex-r4f";
			reg = <0>;
		};
	};
  sram0: memory@8000000 {
		compatible = "mmio-sram";
	};

	flash0: serial-flash@0 {
		compatible = "serial-flash";
	};
